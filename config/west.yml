## config/west.yml
```yaml
manifest:
  remotes:
    - name: zmkfirmware
      url-base: https://github.com/romansavrulin
  projects:
    - name: zmk
      remote: zmkfirmware
      revision: key-merger
      import: app/west.yml
  self:
    path: config
```
